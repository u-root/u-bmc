// SPDX-License-Identifier: GPL-2.0+

partitions {
	compatible = "fixed-partitions";
	#address-cells = <1>;
	#size-cells = <1>;

	u-boot@0 {
		reg = <0x0 0x80000>;
		label = "u-boot";
	};

	ubi@c0000 {
		// The rest of the flash is the ubi area
		reg = <0x80000 0x0>;
		label = "ubi";
	};
};
