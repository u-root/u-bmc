## boot/sign.its
```
/dts-v1/;
/ {
	description = "u-bmc";
	#address-cells = <1>;

	images {
		kernel-1 {
			data = /incbin/("zImage");
			type = "kernel";
			arch = "arm";
			os = "linux";
			compression = "none";
			load = <0x40008000>;
			entry = <0x40008000>;
			hash-1 {
				algo = "sha256";
			};
		};
		fdt-1 {
			description = "platform";
			data = /incbin/("PLATFORM.dtb");
			type = "flat_dt";
			arch = "arm";
			compression = "none";
			hash-1 {
				algo = "sha256";
			};
		};
		ramdisk-1 {
			description = "loader";
			data = /incbin/("../loader.cpio.gz");
			type = "ramdisk";
			arch = "arm";
			compression = "none";
			hash-1 {
				algo = "sha256";
			};
		};
	};
	configurations {
		default = "conf-1";
		conf-1 {
			kernel = "kernel-1";
			fdt = "fdt-1";
			ramdisk = "ramdisk-1";
			signature-1 {
				algo = "sha256,rsa2048";
				key-name-hint = "u-bmc";
				sign-images = "fdt", "kernel", "ramdisk";
			};
		};
	};
};
```
